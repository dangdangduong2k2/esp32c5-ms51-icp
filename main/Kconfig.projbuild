## main/Kconfig.projbuild
```kconfig
menu "MS51FC0AE ICP programmer"

    config MS51_WIFI_SSID
        string "Wi-Fi access point name"
        default "MS51-PROGRAMMER"

    config MS51_WIFI_PASSWORD
        string "Wi-Fi access point password"
        default "12345678"
        help
            WPA2 password. It must contain at least 8 characters.

    config MS51_WIFI_CHANNEL
        int "Wi-Fi channel"
        range 1 13
        default 1

    config MS51_WIFI_TX_POWER_QDBM
        int "Wi-Fi AP maximum TX power (0.25 dBm units)"
        range 8 84
        default 8
        help
            The ESP-IDF minimum is 8, which corresponds to 2 dBm. Lower
            transmit power reduces RF output and power consumption, but also
            reduces Wi-Fi range.

    config MS51_RST_GPIO
        int "ESP32-C5 GPIO connected to MS51 nRESET"
        range 0 28
        default 3

    config MS51_CLK_GPIO
        int "ESP32-C5 GPIO connected to MS51 ICE_CLK/ICP_CLK"
        range 0 28
        default 0

    config MS51_DAT_GPIO
        int "ESP32-C5 GPIO connected to MS51 ICE_DAT/ICP_DAT"
        range 0 28
        default 1

    config MS51_ANALOG_IO1
        bool "Read GPIO1 analog voltage"
        depends on IDF_TARGET_ESP32C5 && MS51_DAT_GPIO != 1 && MS51_CLK_GPIO != 1 && MS51_RST_GPIO != 1
        default n
        help
            Read calibrated ADC1 channel 0 at GPIO1 (0 to 3.3 V).
            Enable only on boards where IO1 is free, e.g. DAT2/CLK3/RS4.

    config MS51_ANALOG_IO6
        bool "Read GPIO6 NTC temperature"
        depends on IDF_TARGET_ESP32C5 && !MS51_ANALOG_IO1 && MS51_DAT_GPIO != 6 && MS51_CLK_GPIO != 6 && MS51_RST_GPIO != 6
        default n
        help
            Read a 10 kohm B3950 NTC to GND with a 10 kohm pullup to 3.3 V.
            GPIO6 is ADC1 channel 5, separate from DAT1/CLK0/RS3.

    config MS51_DEBUG_UART_ENABLE
        bool "Enable MS51 runtime UART/debug over shared ICP wires"
        default y
        help
            While MS51 runs normally, P1.6 / ICE_DAT is UART1 TXD to the
            ESP32 DAT GPIO; P0.2 / ICE_CLK is UART1 RXD from the CLK GPIO.
            This supports telemetry plus runtime EEPROM configuration. Before every
            ICP session the UART driver is removed and both CLK/DAT pins are
            reset to floating inputs; ICP then owns CLK and DAT exclusively.

    config MS51_DEBUG_UART_BAUD
        int "MS51 runtime debug UART baud rate"
        depends on MS51_DEBUG_UART_ENABLE
        range 1200 1000000
        default 115200

    config MS51_BIT_DELAY_US
        int "ICP half-bit delay (microseconds)"
        range 1 20
        default 2
        help
            Delay before/after the active clock edge for normal ICP commands.
            Increase this value when long wiring or level shifters make the
            connection unreliable.

    config MS51_AUTO_PROGRAM
        bool "Program embedded MS51 image at ESP32 startup"
        default n
        help
            If firmware/ms51_app.bin exists and differs from APROM, update only
            the address range covered by that image and verify it. This is off
            by default so merely rebooting the programmer cannot alter a target.
            Locked targets are never mass-erased automatically.

    config MS51_VERIFY_AFTER_PROGRAM
        bool "Verify each changed page after programming"
        default y

    config MS51_PROGRAM_RETRIES
        int "Retries for a page that fails verification"
        range 0 5
        default 2

endmenu
```

## sdkconfig.defaults
```kconfig
CONFIG_ESP_CONSOLE_USB_SERIAL_JTAG=y
CONFIG_ESP_CONSOLE_SECONDARY_NONE=y
CONFIG_MS51_DEBUG_UART_ENABLE=y
CONFIG_MS51_DEBUG_UART_BAUD=115200
CONFIG_LOG_DEFAULT_LEVEL_INFO=y
CONFIG_COMPILER_OPTIMIZATION_SIZE=y
CONFIG_PARTITION_TABLE_CUSTOM=y
CONFIG_PARTITION_TABLE_CUSTOM_FILENAME="partitions.csv"
CONFIG_MS51_WIFI_SSID="MS51-PROGRAMMER"
CONFIG_MS51_WIFI_PASSWORD="12345678"
CONFIG_MS51_WIFI_CHANNEL=1
CONFIG_MS51_WIFI_TX_POWER_QDBM=8
CONFIG_LWIP_IP_FORWARD=y
CONFIG_LWIP_IPV4_NAPT=y
CONFIG_MS51_RST_GPIO=3
CONFIG_MS51_CLK_GPIO=0
CONFIG_MS51_DAT_GPIO=1
CONFIG_MS51_ANALOG_IO5=y
CONFIG_MS51_NTC_50K_IO4=y
CONFIG_MS51_NTC_20K_IO6=y
CONFIG_MS51_BIT_DELAY_US=20
CONFIG_MS51_PROGRAM_RETRIES=2

# Connected ESP32-C5 board has 16 MiB external flash.
CONFIG_ESPTOOLPY_FLASHSIZE_16MB=y

CONFIG_MBEDTLS_CERTIFICATE_BUNDLE=y
CONFIG_MBEDTLS_CERTIFICATE_BUNDLE_DEFAULT_FULL=y

CONFIG_LWIP_SNTP_MAX_SERVERS=3

CONFIG_MBEDTLS_DYNAMIC_BUFFER=y

CONFIG_BT_ENABLED=y
CONFIG_BT_NIMBLE_ENABLED=y
CONFIG_BT_NIMBLE_MAX_CONNECTIONS=1
CONFIG_BT_NIMBLE_NVS_PERSIST=y
CONFIG_BT_NIMBLE_ROLE_CENTRAL=n
CONFIG_BT_NIMBLE_ROLE_OBSERVER=n
CONFIG_BT_NIMBLE_ATT_PREFERRED_MTU=247
# One peripheral connection, acknowledged chunks; no queued long-write workflow.
CONFIG_BT_NIMBLE_ATT_MAX_PREP_ENTRIES=4
CONFIG_BT_NIMBLE_GATT_MAX_PROCS=2
CONFIG_BT_NIMBLE_MSYS_1_BLOCK_COUNT=12
CONFIG_BT_NIMBLE_MSYS_2_BLOCK_COUNT=12
CONFIG_BT_NIMBLE_TRANSPORT_ACL_FROM_LL_COUNT=12
CONFIG_BT_NIMBLE_TRANSPORT_EVT_COUNT=16
# Prefer enough RAM for BLE + TLS + firmware updates over bulk Wi-Fi throughput.
CONFIG_ESP_WIFI_IRAM_OPT=n
CONFIG_ESP_WIFI_EXTRA_IRAM_OPT=n
CONFIG_ESP_WIFI_RX_IRAM_OPT=n
CONFIG_ESP_WIFI_STATIC_RX_BUFFER_NUM=6
CONFIG_ESP_WIFI_DYNAMIC_RX_BUFFER_NUM=16
CONFIG_ESP_WIFI_DYNAMIC_TX_BUFFER_NUM=16
```
